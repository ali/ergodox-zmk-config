## config/west.yml
```yaml
manifest:
  remotes:
    - name: ali
      url-base: https://github.com/ali
  projects:
    - name: zmk
      remote: ali
      revision: main
      import: app/west.yml
  self:
    path: config
```
